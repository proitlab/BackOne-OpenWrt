## backone/Config.in
```kconfig
menu "Configuration"
	depends on PACKAGE_backone

config BACKONE_ENABLE_DEBUG
	bool "Build in debug mode"
	depends on PACKAGE_backone
	default n

config BACKONE_ENABLE_SELFTEST
	bool "Build a self test program"
	depends on PACKAGE_backone
	default n

endmenu
```
